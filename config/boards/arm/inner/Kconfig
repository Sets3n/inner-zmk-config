## config/boards/arm/inner/Kconfig
```kconfig
# Copyright (c) 2022 The ZMK Contributors
# SPDX-License-Identifier: MIT
# iNNER (with eByte E73-2G4M08S1C nrf52840) configuration

config BOARD_ENABLE_DCDC
	bool "Enable DCDC mode"
	select SOC_DCDC_NRF52X
	default y
	depends on BOARD_ACCELERANDO_REDSOIL
```

## config/boards/arm/inner/Kconfig.board
```kconfig
# Copyright (c) 2022 The ZMK Contributors
# SPDX-License-Identifier: MIT
# eByte E73-2G4M08S1C nrf52840 

config BOARD_INNER
    bool "inner"
    depends on SOC_NRF52840_QIAA
```

## config/boards/arm/inner/Kconfig.defconfig
```kconfig
# Copyright (c) 2022 The ZMK Contributors
# SPDX-License-Identifier: MIT
# iNNER (with eByte E73-2G4M08S1C nrf52840) configuration

if BOARD_INNER

config ZMK_KEYBOARD_NAME
    default "iNNER"

if USB

config USB_NRFX
    default y

config USB_DEVICE_STACK
    default y

endif # USB

config BT_CTLR
    default BT

config ZMK_BLE
    default y

config ZMK_USB
    default y

config ZMK_BATTERY_VOLTAGE_DIVIDER
    default y

config ZMK_KEYBOARD_NAME
	default "iNNER"

config IEEE802154_NRF5
	default y
	depends on IEEE802154

config ZMK_KSCAN_MATRIX_POLLING
    default y

endif # BOARD_INNER
```

## config/boards/shields/inner/Kconfig.board
```kconfig
# Accelerando Redsoil (Breakout for eByte E73-2G4M08S1C nrf52840 System-on-module) configuration
config BOARD_INNER
    bool "iNNER"
    depends on SOC_NRF52840_QIAA
```

## config/boards/shields/inner/Kconfig.defconfig
```kconfig
# Copyright (c) 2021 The ZMK Contributors
# SPDX-License-Identifier: MIT
# iNNER (with eByte E73-2G4M08S1C nrf52840 System-on-module) configuration

if SHIELD_INNER

config ZMK_KEYBOARD_NAME
    default "iNNER"

if USB

config USB_NRFX
    default y

config USB_DEVICE_STACK
    default y

endif # USB

config I2C
    default y

config BT_CTLR
    default BT

config ZMK_BLE
    default y

config ZMK_USB
    default y

config ZMK_BATTERY_VOLTAGE_DIVIDER
    default y

endif # BOARD_INNER
```

## config/west.yml
```yaml
#manifest:
#  remotes:
#    - name: Sets3n
#      url-base: https://github.com/Sets3n
#  projects:
#    - name: zmk
#      remote: Sets3n
#      revision: main
#      import: app/west.yml
#  self:
#    path: config
manifest:
  remotes:
    - name: zmkfirmware
      url-base: https://github.com/zmkfirmware
  projects:
    - name: zmk
      remote: zmkfirmware
      revision: main
      import: app/west.yml
  self:
    path: config
```
